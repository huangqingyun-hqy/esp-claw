## application/edge_agent/boards/community/gamebox_s3/sdkconfig.defaults.board
```kconfig
# gamebox_s3 board defaults
# DHT11 backend for lua_module_environmental_sensor
CONFIG_LUA_MODULE_ENVIRONMENTAL_SENSOR_BACKEND_DHT=y

# ESP32-S3-N16R8: 16MB Flash, 8MB Octal PSRAM
CONFIG_ESPTOOLPY_FLASHMODE_QIO=y
CONFIG_ESPTOOLPY_FLASHFREQ_80M=y
CONFIG_ESPTOOLPY_FLASHSIZE_16MB=y
CONFIG_ESPTOOLPY_FLASHSIZE="16MB"
CONFIG_PARTITION_TABLE_CUSTOM=y
CONFIG_PARTITION_TABLE_CUSTOM_FILENAME="partitions_16MB_gamebox.csv"
CONFIG_ESP_DEFAULT_CPU_FREQ_MHZ_240=y
CONFIG_SPIRAM=y
CONFIG_SPIRAM_MODE_OCT=y
CONFIG_SPIRAM_SPEED_80M=y
```
